## esp32s3/main/Kconfig.projbuild
```kconfig
menu "AMY Bench"

    choice BENCH_PACING
        prompt "Render pacing"
        default BENCH_PACING_FREE
        help
            Free-running renders blocks back-to-back for maximum sensitivity
            to per-block cost deltas. Paced mode ticks a GPTimer at the real
            block period (AMY_BLOCK_SIZE / sample rate) and reports overruns,
            measuring realistic headroom instead of raw throughput.

        config BENCH_PACING_FREE
            bool "Free-running (back-to-back blocks)"
        config BENCH_PACING_PACED
            bool "Real-time paced (GPTimer block clock)"
    endchoice

    config BENCH_SAMPLE_RATE
        int "AMY sample rate (Hz)"
        default 48000
        help
            Injected as -DAMY_SAMPLE_RATE. 48000 matches the S3-Amysynth
            production firmware; upstream's generic default is 44100.

    config BENCH_AMY_FLOAT
        bool "Float DSP (AMY_USE_FLOAT) instead of upstream fixed-point"
        default n
        help
            Selects AMY's float arithmetic paths. The ESP32-S3 has a hardware
            FPU and the production firmware runs float; upstream defaults to
            fixed-point. Only compare runs built with the same mode - the run
            header records which one was used.

    config BENCH_PROFILE
        bool "Per-tag profiler build (AMY_DEBUG)"
        default n
        help
            Compiles upstream's AMY_PROFILE instrumentation and emits a
            per-tag breakdown after each scene. Adds a timestamp read at
            every profiled call site, inflating totals - never compare a
            profile-build number against a wall-build number.

    config BENCH_PASSES
        int "Passes over the scene list"
        default 3
        help
            The whole scene list runs this many times; the host compare
            script takes medians across passes.

    config BENCH_SCENE_SELECT
        int "Scene index to run (-1 = all)"
        default -1

    config BENCH_EMIT_PER_BLOCK
        bool "Emit per-block JSONL records"
        default n
        help
            Dumps one JSON line per measured block (after the scene finishes,
            never inside the timed loop). Verbose; summaries are usually
            enough.

endmenu
```

## esp32s3/sdkconfig.defaults
```kconfig
# AMY bench defaults - chosen to match the S3-Amysynth production board/build
# wherever it affects DSP timing (CPU freq, flash mode, PSRAM + XIP, -O2).
CONFIG_IDF_TARGET="esp32s3"
CONFIG_ESP_DEFAULT_CPU_FREQ_MHZ_240=y

CONFIG_ESPTOOLPY_FLASHSIZE_16MB=y
CONFIG_ESPTOOLPY_FLASHMODE_QIO=y
CONFIG_PARTITION_TABLE_CUSTOM=y
CONFIG_PARTITION_TABLE_CUSTOM_FILENAME="partitions.csv"

CONFIG_COMPILER_OPTIMIZATION_PERF=y

# PSRAM present on the board; XIP parity with production (instruction fetch /
# rodata via PSRAM cache affects DSP timing). AMY's own allocations stay in
# internal RAM (default ram_caps_* - no TULIP/AMYBOARD macro defined).
CONFIG_SPIRAM=y
CONFIG_SPIRAM_MODE_OCT=y
CONFIG_SPIRAM_SPEED_80M=y
CONFIG_SPIRAM_XIP_FROM_PSRAM=y

# The bench runs entirely in the main task: render + report, single core.
# Core 1 mirrors production (AMY DSP renders on core 1 there).
CONFIG_ESP_MAIN_TASK_STACK_SIZE=16384
CONFIG_ESP_MAIN_TASK_AFFINITY_CPU1=y

# Free-running mode renders back-to-back without yielding, so the CPU1 idle
# task starves and the task WDT warning fires every 5 s - each fire interrupts
# CPU1 to collect a backtrace (skews timed blocks) and pollutes the JSONL
# stream. Stop watching that idle task only; the task WDT itself and the
# interrupt WDT remain enabled.
CONFIG_ESP_TASK_WDT_CHECK_IDLE_TASK_CPU1=n
```

## esp32s3/sdkconfig.defaults.lto
```kconfig
# Overlay: LTO profile. Apply with
#   idf.py -D SDKCONFIG_DEFAULTS="sdkconfig.defaults;sdkconfig.defaults.lto" reconfigure build
# Needs the patched gcc.cmake copied into
# managed_components/espressif__cmake_utilities/ first (see bench/README.md).
CONFIG_CU_GCC_LTO_ENABLE=y
```
